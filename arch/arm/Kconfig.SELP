## arch/arm/plat-sdp/Kconfig
```kconfig
if ARCH_SDP

menu "Samsung SDPXX SoC H/W introduce"

# Interrupt controller option
choice
	prompt "SDP Interrupt controller policy"
	default INTC_PRIORITY

config INTC_PRIORITY
	bool "Priority interrupt policy"

config INTC_NOT_NESTED	
	bool "Don't support to be nested"

config INTC_NONE
	bool "Interrupt policy is none"

endchoice 

config POLL_INTR_PEND
	bool "Polling interrupt pending reg instead of idle"
	default y


#config CHECK_ISRTIME
#	bool "Check to take ISR time"
# Interrupt controller option


# UART 
config SERIAL_SDP
	tristate "Samsung SDPXX SoC serial port support"
	depends on ARCH_SDP
	select SERIAL_CORE

config SERIAL_SDP_CONSOLE
	bool "Support for console on Samsung SDPXX SoC"
	depends on SERIAL_SDP=y
	select SERIAL_CORE_CONSOLE
# UART end



# I2C
config SDP_I2C
        depends on ARCH_SDP83 || ARCH_SDP92 || ARCH_SDP93
        bool "Samsung SDP SoC I2c driver without i2c layer in kernel"
# I2C end


# GPIO
config SDP92_GPIO
	default y
	bool "SDP GPIO driver glue logic for SDP92"
	depends on SDP92
	select SDP_GPIO

config SDP83_GPIO
	default y
	bool "SDP GPIO driver glue logic for SDP83"
	depends on SDP83
	select SDP_GPIO

config SDP_GPIO
	default y
        bool "Samsung SDP SoC standalone GPIO driver"
# GPIO end


# Timer
choice
	prompt "SDP Timer type"
	default SDP_TIMER

config SDP_TIMER
	bool "Use Basic tick timer"

config SDP_SUPPORT_HRTIMER
	bool "Use high-resolution timer"
	select GENERIC_TIME
	select GENERIC_CLOCKEVENTS
	select HIGH_RES_TIMERS
endchoice
# Timer end

# WFI Command Not use for ARMv6 based SoC
config NOT_USE_WFI
	bool "Not use WFI command"
	depends on ARCH_SDP83
# WFI Command Not use for ARMv6 based SoC end


# PCI
# sdp-pci menu
config SDP_PCI
	default y
	depends on PCI && ARCH_SDP83
	bool "SDP PCI bus driver"

config SDP_PCIE
	default y
	depends on PCI && (ARCH_SDP92 || ARCH_SDP93) 
	bool "SDP PCI Express RC driver"

# sdp-pci:pci-clock
choice
	prompt "SDP PCI clock type"
	depends on SDP_PCI
	default SDP_PCI_EXT_CLK

config SDP_PCI_EXT_CLK
        depends on SDP_PCI
        bool "Use PCI External Clock"

config SDP_PCI_INTERNAL_33MHZ
        depends on SDP_PCI
        bool "Use PCI Internal 33Mhz Clock"

config SDP_PCI_INTERNAL_66MHZ
        depends on SDP_PCI
        bool "Use PCI Internal 66Mhz Clock"

endchoice
# PCI end

# Ethernet 
source "arch/arm/plat-sdp/sdpGmac/Kconfig"


# Ethernet ethernet eeprom
config SDP_ETH_NO_EEPROM
        default n
	depends on MACH_LEONID_XXX
        bool "Don't Support Ethernet EEPROM"
        help

config S5H2X_CS8900
	default n
	depends on MACH_LEONID_XXX
	bool

config S5H2X_CS8900_NO_EEPROM
	default n
	depends on MACH_LEONID_XXX
	bool

endmenu

endif
```

## arch/arm/plat-sdp/sdpGmac/Kconfig
```kconfig
if ARCH_SDP

config SDP_GMAC
	depends on ARCH_SDP92 || ARCH_SDP93
	tristate "SDP GMAC Driver"
	select NETDEVICES
	select NET_ETHERNET
	select MII

choice 
	prompt "SDP GMAC set mac address"
	default MAC_SET_BY_USER

config MAC_GET_I2C
	depends on SDP_I2C && SDP_GMAC
	bool	"SDP GMAC get mac address from i2c device"

config MAC_SET_BY_USER
	depends on SDP_GMAC
	bool 	"SDP GMAC set mac address by user"

config MAC_GET_FLASH
	depends on SDP_GMAC
	bool	"SDP GAMC get mac address from falsh device"


endchoice


if MAC_GET_I2C
config MAC_I2C_PORT
	depends on MAC_GET_I2C
	int 	"SDP GMAC i2c device port number"
	default 1

config MAC_I2C_SLV_ADDR
	depends on MAC_GET_I2C
	hex	"SDP GMAC i2c device slave address"
	default 0xA0

config MAC_I2C_SUBADDR_NR
	depends on MAC_GET_I2C
	int	"SDP GMAC i2c number of sub addresses"
	default 2

config MAC_I2C_SUBADDR
	depends on MAC_GET_I2C
	hex	"SDP GMAC i2c sub address"
	default 0x10
endif # MAC_GET_I2C

if MAC_SET_BY_USER
config MAC_FRONT_4BYTE
	depends on MAC_SET_BY_USER
	hex 	"SDP GMAC Mac address front 4 byte"
	default 0x11223344

config MAC_END_2BYTE
	depends on MAC_SET_BY_USER
	hex 	"SDP GMAC Mac address end 2 byte"
	default 0x5566

endif # MAC_SET_BY_USER

if MAC_GET_FLASH
config MAC_FLASH_PARTITION
	depends on MAC_GET_FLASH
	string	"SDP GMAC Flash Partition device name"
	default "/dev/tbml12"

endif # MAC_GET_FLASH



endif
```

## arch/ppc/Kconfig.debug
```kconfig
menu "Kernel hacking"

source "lib/Kconfig.debug"

config XMON
	bool "Include xmon kernel debugger"
	depends on DEBUG_KERNEL && !KGDB
	help
	  Include in-kernel hooks for the xmon kernel monitor/debugger.
	  Unless you are intending to debug the kernel, say N here.

config BDI_SWITCH
	bool "Include BDI-2000 user context switcher"
	depends on DEBUG_KERNEL
	help
	  Include in-kernel support for the Abatron BDI2000 debugger.
	  Unless you are intending to debug the kernel with one of these
	  machines, say N here.

config SERIAL_TEXT_DEBUG
	bool "Support for early boot texts over serial port"
	depends on 4xx || LOPEC || MV64X60 || PPLUS || PRPMC800 || \
		PPC_GEN550 || PPC_MPC52xx

config PPC_OCP
	bool
	depends on IBM_OCP
	default y

config KFT
	bool "Kernel Function Trace"
	help
	  Say Y here to turn on kernel function tracing. 
	  This allows you to get a trace of kernel functions
	  during kernel execution.  This can be helpful for
	  debugging, but adds overhead to every kernel function
	  invocation.  The overhead is small, but still present,
	  even when tracing is not active.

	  See the file Documentation/kft.txt for more information.
          Say N here if you are unsure.

config KFT_STATIC_RUN
	bool "Static function tracing configuration"
	depends on KFT
	help
	  Say Y here to compile the KFT configuration statically
	  into the kernel.  This is needed if you plan to use KFT
	  to get information about function timings on kernel bootup
	  (prior to the kernel starting user space).  To do this, you
	  need to create a valid kernel/kftstatic.conf file.

config KFT_SAVE_ARGS
	bool "Save function arguments in the trace log"
	depends on KFT
	default n 
	help
	  Say Y here to have KFT save the first few arguments to
	  the function, in the trace log entry for that function.
	  This will approximately double the size of the trace
	  log buffer.

endmenu
```

## drivers/media/video/omap/Kconfig
```kconfig
menu "OMAP16xx V4L2 drivers"
	depends on VIDEO_DEV && ARCH_OMAP16XX
config VIDEO_OMAP_CAMERA
	tristate "OMAP Camera support (EXPERIMENTAL)"
	select VIDEOBUF_GEN
	select VIDEOBUF_DMA_SG
	depends on VIDEO_DEV && (ARCH_OMAP16XX || ARCH_OMAP24XX)
	help
	  V4L2 camera driver support for OMAP1/2 based boards.
	
config VIDEO_CAMERA_SENSOR_OV9640
	tristate "OV9640 sensor support"
	depends on VIDEO_OMAP_CAMERA
	help
	  OmniVision 9640 camera sensor support
endmenu

menu "OMAP2/OMAP3 V4L2 drivers"
	depends on VIDEO_DEV && (ARCH_OMAP24XX || ARCH_OMAP34XX)

config VIDEO_OMAP24XX_VIDEOLIB
	tristate "Video out library"

config VIDEO_OMAP24XX_VIDEOOUT
	tristate "Video out driver"
	depends on VIDEO_OMAP24XX_VIDEOLIB
	select VIDEOBUF_GEN
	select VIDEOBUF_DMA_SG

config VIDEO_OMAP24XX_TVOUT
	bool "TV out support"

config VIDEO_OMAP34XX_CAMERA
	tristate "Camera driver"
	depends on VIDEO_OMAP24XX_VIDEOLIB && ARCH_OMAP34XX 
	select VIDEOBUF_GEN
	select VIDEOBUF_DMA_SG

config VIDEO_OMAP34XX_SECLCD
	tristate "Secondary LCD driver"
	depends on VIDEO_OMAP24XX_VIDEOLIB && ARCH_OMAP34XX 
	select VIDEOBUF_GEN
	select VIDEOBUF_DMA_SG

config VIDEO_OMAP_SENSOR_MT9D111
	tristate "Micron mt9d111 (EX3691) ISP sensor driver"
	depends on ARCH_OMAP2430 || ARCH_OMAP34XX  

config VIDEO_OMAP_SENSOR_MT9T012
	tristate "Micron mt9t012 raw sensor driver (3MP)"
	depends on ARCH_OMAP34XX  && !OMAP3430_ES2
	default y

config VIDEO_OMAP_SENSOR_MT9P012
	tristate "Micron mt9p012 raw sensor driver (5MP)"
	depends on ARCH_OMAP34XX && OMAP3430_ES2
	default y

config VIDEO_OMAP_AF_D88
	tristate "Auto Focus driver coil D88"
	depends on ARCH_OMAP34XX && VIDEO_OMAP_SENSOR_MT9P012 && OMAP3430_ES2
	default y

config VIDEO_OMAP_SENSOR_OV3640
	tristate "OV3640 sensor support (3MP)"
	depends on ARCH_OMAP34XX && OMAP3430_ES2 && !VIDEO_OMAP_SENSOR_MT9P012

source "drivers/media/video/omap/isp/Kconfig"
source "drivers/media/video/omap/gci/Kconfig"
endmenu
```

## drivers/net/r8101/Kconfig
```kconfig
config R8101_VER1012
	tristate "RealTek RTL-8101/8103 PCIE Fast Ethernet Driver Ver 1.012"
	depends on NET_PCI && PCI && !R8169
	select CRC32
	select MII
	select R8101_NAPI

config R8101_NAPI
	bool
```
