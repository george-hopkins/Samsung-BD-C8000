## arch/arm/Kconfig.SELP
```kconfig
menu Samsung

## SELP Menu Start: config file  for SELP.4.3.x Cortex-A8 Features ##
menu "Samsung SELP Option"
comment "SELP.4.3.x"

config SHOW_FAULT_TRACE_INFO
       bool "Show Trace Info on User Page Fault"
       default y
       help
        Show trace information when occurred "Segmentation Fault" or "Bus Error"
        Prints registers, call stack, maps, user stack, etc.

config SHOW_THREAD_GROUP_STACK 
       bool "Show Thread Group's Stack on User Page Fault" 
       default n
       depends on SHOW_FAULT_TRACE_INFO
       help 
        Show thread group's user stack with basic fault trace information.
        It may be useful when one thread occurred fault,
        but another thread is a criminal.
        Be careful when using this option,
        because dumping all thread's stack can generate very long message.

config SEPARATE_PRINTK_FROM_USER
       bool "It separate messgaes(printf, printk) between user and kernel."
       default n
       help
        Show trace information when occurred "Segmentation Fault" or "Bus Error"
        Prints registers, call stack, maps, etc.

config RSS_INFO
       bool "Support to print rss information of process memory"
       default y
       help
        Enable to print information of rss

config SERIAL_INPUT_MANIPULATION
       bool "Manipulate Serial INPUT in N_TTY"
       help
         decide whether serial input by user is enabled or not

config SERIAL_INPUT_ENABLE_STRING
       string "Serial Input Enable String(Max 10 character)"
       default "debug"
       depends on SERIAL_INPUT_MANIPULATION=y
       help
        default string that enable serial input by user

config SERIAL_INPUT_DISABLE_STRING
       string "Serial Input Disable String(Max 10 character)"
       default "~~bye"
       depends on SERIAL_INPUT_MANIPULATION=y
       help
        default string that disable serial input by user

config SERIAL_INPUT_DEFAULT_SETUP_ENABLE
       bool "Serial Input enable Setup at boot"
       default n
       depends on SERIAL_INPUT_MANIPULATION=y

config SERIAL_INPUT_MANIPULATION_PORTNUM
       int "Serial Input Manipulation Port Line Number"
       default 0
       depends on SERIAL_INPUT_MANIPULATION=y

config SERIAL_INPUT_ENABLE_ONLY_NUMBER
       bool "Input enabled only 0~9, space, enter and backspace"
	   default n
	   depends on SERIAL_INPUT_MANIPULATION=y

config KDEBUGD
	    bool "KDEBUGD - core"
	    default n
        depends on SHOW_FAULT_TRACE_INFO
        depends on SERIAL_INPUT_MANIPULATION 
    	help
          kdebugd - kernel debugging helper 
          kdebugd is a good solution for kernel hacker who want to know 
          kernel information easily.

config KDEBUGD_STRING
	    string "KDEBUGD_STRING"
        default "SP_DEBUG" 
        depends on KDEBUGD 

config KDEBUGD_MISC
	    bool "KDEBUGD - miscellaneous functions"
	    default y
        depends on KDEBUGD
    	help
          kdebugd - kernel debugging helper 
          1. A list of tasks and their relation information
          2. A list of tasks and their priority information
          3. A list of tasks and their inforamtion + backtrace(kernel)
          4. Turn On/Off O(1) Scheduler prints
          5. Dump task register with pid
          6. Dump task maps with pid
          7. Dump user stack with pid
          8. Memory Integrity Checker
          9. Trace thread execution(look at PC)
          10. Schedule history logger

config KDEBUGD_TRACE
	    bool "KDEBUGD - backtrace"
	    default y
        depends on KDEBUGD_MISC
    	help
          kdebugd - backtrace
          1. Dump backtrace(User)

config KDEBUGD_COUNTER_MONITOR
           bool "KDEBUGD - counter monitor"
           default y
        depends on KDEBUGD
       help
          kdebugd - counter monitor
          1. CPU Usage
          2. CPU Usage for each thread
          3. Memory Usage
          4. Disk Usage
          5. Network Usage 

config KDEBUGD_CPUUSAGE_BUFFER_SIZE
       int "CPU usage buffer size"
       default 120
       depends on KDEBUGD_COUNTER_MONITOR

config KDEBUGD_TOPTHREAD_BUFFER_SIZE
       int "Topthread buffer size"
       default 120
       depends on KDEBUGD_COUNTER_MONITOR
 
config KDEBUGD_MAX_TOPTHREAD
       int "Max count of top thread cpu usage"
       default 5
       depends on KDEBUGD_COUNTER_MONITOR

config KDEBUGD_MEMUSAGE_BUFFER_SIZE
       int "Memory usage buffer size"
       default 120
       depends on KDEBUGD_COUNTER_MONITOR
 
config KDEBUGD_DISKUSAGE_BUFFER_SIZE
       int "Disk usage buffer size"
       default 120
       depends on KDEBUGD_COUNTER_MONITOR
 
config KDEBUGD_NETUSAGE_BUFFER_SIZE
       int "Network usage buffer size"
       default 120
       depends on KDEBUGD_COUNTER_MONITOR

config ADVANCE_OPROFILE
        bool "Advance OProfile"
        default y
       depends on KDEBUGD
       depends on OPROFILE

config DTVLOGD
      bool "DTVLOGD serial message logging system"
      default y
      help
        Saving all serial message into memory buffer.

#config DTVLOGD_EMERGENCY_LOG
#      bool "DTVLOGD - Emergency Log"
#      default n
#      depends on DTVLOGD
#      help
#       Save emergency serial message into flash.

config DTVLOGD_USB_LOG
      bool "DTVLOGD - USB Log"
      default n
      depends on DTVLOGD
      help
       Save all serial message into usb.

config SHOW_LOCK_WAITING_LIST
      bool "It display futex, sem waiting list."
      depends on SHOW_FAULT_TRACE_INFO && SERIAL_INPUT_MANIPULATION
      default n
      help
       It display futex, sem waiting list.

config SHOW_LOCK_WAITING_LIST_COMMAND
      string "Command for showing waiting futex,semop list"
      default showlist
      depends on SHOW_FAULT_TRACE_INFO && SERIAL_INPUT_MANIPULATION && SHOW_LOCK_WAITING_LIST

config CHECK_THREAD_NAME
    bool "Checking whether thread name is changed or not"
    default n
    help
      If check this option, print PID, TID of thread whose name is not changed
      depends on SHOW_FAULT_TRACE_INFO

config THREAD_NAME_FOR_NAME_CHECKER
    string "Thread name for Name cheker"
    default "exeDSP"
    depends on CHECK_THREAD_NAME

config CHECK_THREAD_NAME_CONTEXT_CNT
    int "Threshold value for thread naming check"
    default 3
    depends on CHECK_THREAD_NAME

config BOOTPROFILE
	bool "Boot Profile"
	default n
	help
	  Tool for performance analysis and visualization of boot process.


config RAMZSWAP                                                                                                                           
       bool "RAMZSWAP support"                                                                                                            
       default n                                                                                                                          
       depends on SWAP && LZO_COMPRESS && LZO_DECOMPRESS                                                                                  
       help                                                                                                                               
            RAM based block device which acts as swap disk.                                                                               

config RAMZSWAP_SIZE
       int "Ramzswap swap size"
       default 204800
       depends on RAMZSWAP
       help 
           Swap size




config BD_CACHE_ENABLED
	bool "BD Cache Enable"
	default y
	help
	  Blu-ray cache enable/disable

config SSIF_EXT_CACHE
       bool "BD UDF Extents Cache (for 3D BD)"
       default y
       help
         The 3D Blu-ray has many extents. So it make slow read problem when play it.
         This problem also occur even we play 3D Blu-ray with 2D mode.
         So remember last accessed inode to enhance read performance of 3D Blu-ray.

source "mm/Kconfig.SELP.FASTBOOT"

endmenu # end of "Samsung SELP Option" menu
endmenu # end of "Samsung" menu
```

## arch/arm/mach-sdp/Kconfig
```kconfig
if ARCH_SDP

menu "SDPXX SoC Machine type"

choice
	prompt "DTV/BD SoC Type"
	default ARCH_SDP92

config ARCH_SDP92
	bool "Samsung DTV Project - SDP92(Valencia, Cortex-A8)"
	select CPU_V7
	select VFP

config ARCH_SDP93
	bool "Samsung BD Project - SDP93(Barcelona, Cortex-A8)"
	select CPU_V7
	select VFP

config ARCH_SDP83
	bool "Samsung DTV Project - SDP83(Chelsea, ARM1176JZF-S)"
	select CPU_V6
	select VFP
endchoice

if ARCH_SDP92

# board type
choice
	prompt "SDP92 Board type"
	default MACH_AQUILA

config MACH_AQUILA
	depends on ARCH_SDP92
	bool "Samsung Aquila - Valencia evaluation board."
endchoice

endif


if ARCH_SDP93

# board type
choice
	prompt "SDP93 Board type"
	default MACH_CORONA

config MACH_CORONA
	depends on ARCH_SDP93
	bool "Samsung Corona - Barcelona evaluation board."

endchoice

endif



if ARCH_SDP83
choice
	prompt "SDP83 Board type Type"
	default MACH_LEONID

config MACH_LEONID
	depends on ARCH_SDP83
	bool "Samsung Leonid 384MB,64bit"
	select MACH_LEONID_XXX
endchoice

endif # ARCH_SDP83



config MACH_LEONID_XXX
	default n
	depends on MACH_LEONID
	bool "Samsung Leonid board series"
	select PCI
	select SDP_PCI

# Discontinous mem support
if MACH_LEONID_XXX || MACH_AQUILA || MACH_CORONA

choice
	prompt "System memory"
	default SDP_DISCONTIGMEM_SUPPORT

config SDP_DISCONTIGMEM_SUPPORT
        bool "Discontinous memory support"
        select ARCH_DISCONTIGMEM_ENABLE

config SDP_SINGLE_DDR_A
	bool "Use DDR A channel only"

config SDP_SINGLE_DDR_B
	bool "Use DDR B channel only"

endchoice

endif	# MACH_LEONID_XXX || MACH_AQUILA


# SDP92 AQUILA memory map
if MACH_AQUILA
choice
	prompt "SDP92 Aquila memory map type"
	default AQUILA_MEMORY_MAP_266

config AQUILA_MEMORY_MAP_266
	bool "Total 266MB (142/124)"
	
config AQUILA_MEMORY_MAP_SDECODE
	bool "Total 300MB for 'single decoding scenario'(190/110)"

endchoice	
endif	# MACH_AQUILA

# SDP93 CORONA memory map
if MACH_CORONA
choice
	prompt "SDP93 Corona memory map type"
	default CORONA_MEMMAP_40_130
	
config CORONA_MEMMAP_40_20
	bool "Total 60MB (40/20)"
	select SDP_DISCONTIGMEM_SUPPORT

config CORONA_MEMMAP_40_30
	bool "Total 70MB (40/30)"
	select SDP_DISCONTIGMEM_SUPPORT

config CORONA_MEMMAP_40_130
	bool "Total 170MB (40/130)"
	select SDP_DISCONTIGMEM_SUPPORT

config CORONA_MEMMAP_90_80
	bool "Total 170MB (90/80)"
	select SDP_DISCONTIGMEM_SUPPORT

config CORONA_MEMMAP_50_50
	bool "Total 100MB (50/50)"
	select SDP_DISCONTIGMEM_SUPPORT

config CORONA_MEMMAP_56_66
	bool "Total 122MB (56/66)"
	select SDP_DISCONTIGMEM_SUPPORT

config CORONA_MEMMAP_50_300
	bool "Total 350MB(50/300)"
	select SDP_DISCONTIGMEM_SUPPORT

endchoice	
endif	# MACH_CORONA

if MACH_CORONA
choice
	prompt "Flash Type 1GB(BD)/128MB(TV+BD)"
	default FLASH_FLEX_1GB

config FLASH_FLEX_1GB
	bool "FlexOneNAND 1GB"

config FLASH_ONENAND_128MB
	bool "OneNAND 128MB"

endchoice
endif	# MACH_CORONA

config MIPS_BCM_NDVD
	depends on ARCH_SDP93
	bool "Broadcom 7601 UDF patch"

endmenu

endif
```

## arch/arm/mach-ssdtv/Kconfig
```kconfig
if ARCH_SSDTV

menu "Samsung DTV SOC Project H/W introduce"

choice
	prompt "SDPXX SoC Type"
	default ARCH_SDP78FPGA

config ARCH_SDP83
	bool "Samsung DTV Project - SDP83(Chelsea, ARM1176JZF-S)"
	select CPU_V6
	select VFP

endchoice


if ARCH_SSA1FPGA

choice
	prompt "A1 FPGA Board type Type"
	default MACH_A1FPGA

config MACH_A1FPGA
	depends on ARCH_SSA1FPGA
	bool "Samsung A1 FPGA"
#	select PCI
#	select S5H2X_CS8900
#	select S5H2X_CS8900_NO_EEPROM
endchoice

endif

if ARCH_SDP75
choice
	prompt "SDP75 Board type Type"
	default MACH_POLARIS

config MACH_POLARIS
	depends on ARCH_SDP75
	bool "Samsung Polaris (SDP75 Evaluation board)"
	select ARM_AMBA
	select PCI
	select SSDTV_PCI
endchoice
endif

if ARCH_SDP78FPGA
choice
	prompt "SDP78FPGA Board Type"
	default MACH_SDP78FPGA

config MACH_SDP78FPGA
	bool "Samsung SDP78 FPGA"
	select ARM_AMBA
endchoice

config SYSTEM_CLOCK
	hex "FPGA System Clock"
	depends on ARCH_SDP78FPGA
	default "0x18000000"
endif

if ARCH_SDP83
choice
	prompt "SDP83 Board type Type"
	default MACH_LEONID

config MACH_LEONID
	depends on ARCH_SDP83
	bool "Samsung Leonid 384MB,64bit"
	select ARM_AMBA
	select MACH_LEONID_XXX

config MACH_LEONID64512
	depends on ARCH_SDP83
	bool "Samsung Leonid 512MB,64bit"
	select ARM_AMBA
	select MACH_LEONID_XXX

config MACH_LEONID64256
	depends on ARCH_SDP83
	bool "Samsung Leonid 256MB,64bit"
	select ARM_AMBA
	select MACH_LEONID_XXX

config MACH_LEONID48320
	depends on ARCH_SDP83
	bool "Samsung Leonid 320MB,48bit"
	select ARM_AMBA
	select MACH_LEONID_XXX

config MACH_LEONID48256
	depends on ARCH_SDP83
	bool "Samsung Leonid 256MB,48bit"
	select ARM_AMBA
	select MACH_LEONID_XXX

config MACH_LEONID48US
	depends on ARCH_SDP83
	bool "Samsung Leonid 192MB,48bit US"
	select MACH_LEONID_XXX
	select ARM_AMBA

config MACH_LEONID48EU
	depends on ARCH_SDP83
	bool "Samsung Leonid 192MB,48bit EU"
	select MACH_LEONID_XXX
	select ARM_AMBA

config MACH_LEONID32US
	depends on ARCH_SDP83
	bool "Samsung Leonid 128MB,32bit US"
	select MACH_LEONID_XXX
	select ARM_AMBA

endchoice
config SDP83_GPIO
	bool "SDP GPIO driver glue logic for SDP83"
	select ARCH_REQUIRE_SDP_GPIO
endif

# Samsung SDP83 Chelsea Evaluation board series
config MACH_LEONID_XXX
	default n
	depends on MACH_LEONID || MACH_LEONID48EU || MACH_LEONID48US || MACH_LEONID48320 || MACH_LEONID48256
	bool "Samsung SDP83 Chelsea Evaluation board series"
	select PCI
	select SSDTV_PCI

# SELP.arm.3.x support A1 2007-10-22
if MACH_POLARIS
choice
        prompt "Choose Linux Kernel Memory"
        default SYS_MEM_EAST

config SYS_MEM_WEST
        depends on MACH_POLARIS
        bool "West Base(0x60008000)"

config SYS_MEM_EAST
        depends on MACH_POLARIS
        bool "East Base(0xD0008000)"
endchoice
endif

# Interrupt policy
choice
	prompt "SSDTV Interrupt controller policy"
	default INTC_PRIORITY

config INTC_PRIORITY
	bool "Priority interrupt policy"

config INTC_NOT_NESTED	
	bool "Don't support to be nested"

config INTC_NONE
	bool "Interrupt policy is none"
endchoice

#config CHECK_ISRTIME
#	bool "Check to take ISR time"

# Interrupt policy end

# Hrtimer 
choice
	prompt "SSDTV Timer type"
	default SSDTV_TIMER

config SSDTV_TIMER
	bool "ssdtv support tick timer"
	help

config SSDTV_SUPPORT_HRTIMER
	bool "ssdtv support hrtimer"
	depends on MACH_POLARIS || MACH_LEONID_XXX
	select GENERIC_TIME
	select GENERIC_CLOCKEVENTS
	select HIGH_RES_TIMERS
	help

endchoice
# Hrtimer end

# WFI Command Not use
config NOT_USE_WFI
	bool "Not use WFI command"
# WFI Command Not use End

# Discontinous mem support
config SSDTV_DISCONTIGMEM_SUPPORT
	depends on MACH_POLARIS || MACH_LEONID_XXX
        bool "Discontinous memory support" if !SYS_MEM_EAST && !SYS_MEM_B
        select ARCH_DISCONTIGMEM_ENABLE
# Discontinous mem support end

# ssdtv-pci menu
config SSDTV_PCI
	default y
	depends on PCI
	bool "SSDTV PCI bus driver"

# ssdtv-pci:pci-clock
choice
	prompt "SSDTV PCI clock type"
	depends on SSDTV_PCI
	default SSDTV_PCI_EXT_CLK

config SSDTV_PCI_EXT_CLK
        depends on SSDTV_PCI
        bool "Use PCI External Clock"

config SSDTV_PCI_INTERNAL_33MHZ
        depends on SSDTV_PCI
        bool "Use PCI Internal 33Mhz Clock"

config SSDTV_PCI_INTERNAL_66MHZ
        depends on SSDTV_PCI
        bool "Use PCI Internal 66Mhz Clock"

endchoice

# Ethernet ethernet eeprom
config SSDTV_ETH_NO_EEPROM
        default n
        bool "Don't Support Ethernet EEPROM"
        help

config S5H2X_CS8900
	default n
	bool

config S5H2X_CS8900_NO_EEPROM
	default n
	bool
endmenu

endif
```
